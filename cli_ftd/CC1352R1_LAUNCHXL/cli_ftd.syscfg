/**
 * @cliArgs --board "/ti/boards/CC1352R1_LAUNCHXL" --product "simplelink_cc13x2_26x2_sdk@4.20.01.04"
 * @versions {"data":"2020090214","timestamp":"2020090214","tool":"1.6.0+1543","templates":"2020090214"}
 */

/**
 * Import the modules used in this configuration.
 */
const CCFG      = scripting.addModule("/ti/devices/CCFG");
const rfdesign  = scripting.addModule("/ti/devices/radioconfig/rfdesign");
const Display   = scripting.addModule("/ti/display/Display");
const Display1  = Display.addInstance();
const AESCCM    = scripting.addModule("/ti/drivers/AESCCM");
const AESCCM1   = AESCCM.addInstance();
const AESECB    = scripting.addModule("/ti/drivers/AESECB");
const AESECB1   = AESECB.addInstance();
const DMA       = scripting.addModule("/ti/drivers/DMA");
const ECDH      = scripting.addModule("/ti/drivers/ECDH");
const ECDH1     = ECDH.addInstance();
const ECDSA     = scripting.addModule("/ti/drivers/ECDSA");
const ECDSA1    = ECDSA.addInstance();
const ECJPAKE   = scripting.addModule("/ti/drivers/ECJPAKE");
const ECJPAKE1  = ECJPAKE.addInstance();
const GPIO      = scripting.addModule("/ti/drivers/GPIO");
const GPIO1     = GPIO.addInstance();
const GPIO2     = GPIO.addInstance();
const GPIO3     = GPIO.addInstance();
const GPIO4     = GPIO.addInstance();
const I2C       = scripting.addModule("/ti/drivers/I2C", {}, false);
const I2C1      = I2C.addInstance();
const NVS       = scripting.addModule("/ti/drivers/NVS");
const NVS1      = NVS.addInstance();
const Power     = scripting.addModule("/ti/drivers/Power");
const RF        = scripting.addModule("/ti/drivers/RF");
const SHA2      = scripting.addModule("/ti/drivers/SHA2");
const SHA21     = SHA2.addInstance();
const TRNG      = scripting.addModule("/ti/drivers/TRNG");
const TRNG1     = TRNG.addInstance();
const Watchdog  = scripting.addModule("/ti/drivers/Watchdog");
const Watchdog1 = Watchdog.addInstance();
const thread    = scripting.addModule("/ti/thread/thread");

/**
 * Write custom configuration values to the imported modules.
 */
CCFG.enableBootloader         = true;
CCFG.enableBootloaderBackdoor = true;
CCFG.dioBootloaderBackdoor    = 15;
CCFG.levelBootloaderBackdoor  = "Active low";
CCFG.forceVddr                = true;
CCFG.ccfgTemplate.$name       = "ti_devices_CCFGTemplate0";

Display1.$name                             = "CONFIG_DISPLAY";
Display1.uartBufferSize                    = 128;
Display1.$hardware                         = system.deviceData.board.components.XDS110UART;
Display1.uart.$name                        = "CONFIG_DISPLAY_UART";
Display1.uart.txPinInstance.$name          = "CONFIG_PIN_UART_TX";
Display1.uart.txPinInstance.outputState    = "High";
Display1.uart.txPinInstance.outputStrength = "Minimum";
Display1.uart.rxPinInstance.$name          = "CONFIG_PIN_UART_RX";
Display1.uart.uart.$assign                 = "UART0";

AESCCM1.$name = "CONFIG_AESCCM_0";

AESECB1.$name = "CONFIG_AESECB_0";

ECDH1.$name = "CONFIG_ECDH_0";

ECDSA1.$name = "CONFIG_ECDSA_0";

ECJPAKE1.$name = "CONFIG_ECJPAKE_0";

GPIO.optimizeCallbackTableSize = true;

GPIO1.$hardware              = system.deviceData.board.components["BTN-1"];
GPIO1.$name                  = "CONFIG_GPIO_BTN1";
GPIO1.pinInstance.$name      = "CONFIG_PIN_BTN1";
GPIO1.pinInstance.hysteresis = true;
GPIO1.pinInstance.irq        = "Both Edges";

GPIO2.$hardware              = system.deviceData.board.components["BTN-2"];
GPIO2.$name                  = "CONFIG_GPIO_BTN2";
GPIO2.pinInstance.$name      = "CONFIG_PIN_BTN2";
GPIO2.pinInstance.hysteresis = true;
GPIO2.pinInstance.irq        = "Both Edges";

GPIO3.$hardware                  = system.deviceData.board.components.LED_GREEN;
GPIO3.$name                      = "CONFIG_GPIO_GLED";
GPIO3.pinInstance.$name          = "CONFIG_PIN_GLED";
GPIO3.pinInstance.outputStrength = "Maximum";

GPIO4.$hardware                  = system.deviceData.board.components.LED_RED;
GPIO4.$name                      = "CONFIG_GPIO_RLED";
GPIO4.pinInstance.$name          = "CONFIG_PIN_RLED";
GPIO4.pinInstance.outputStrength = "Maximum";

I2C1.$name                = "CONFIG_I2C_0";
I2C1.sdaPinInstance.$name = "CONFIG_PIN_0";
I2C1.clkPinInstance.$name = "CONFIG_PIN_1";

NVS1.$name                    = "CONFIG_NVSINTERNAL";
NVS1.internalFlash.$name      = "ti_drivers_nvs_NVSCC26XX0";
NVS1.internalFlash.regionBase = 0x52000;
NVS1.internalFlash.regionSize = 0x4000;

SHA21.$name = "CONFIG_SHA2_0";

TRNG1.$name = "CONFIG_TRNG_0";

Watchdog1.$name            = "CONFIG_WATCHDOG0";
Watchdog1.watchdog.$assign = "WDT0";

thread.deviceTypeReadOnly                    = true;
thread.pm.$name                              = "ti_thread_pm_thread_pm0";
thread.rf.$name                              = "ti_thread_rf_thread_rf0";
thread.rf.radioConfig.$name                  = "ti_devices_radioconfig_settings_ieee_15_40";
thread.rf.radioConfig.codeExportConfig.$name = "ti_devices_radioconfig_code_export_param0";
thread.network.$name                         = "ti_thread_network_thread_network0";
thread.security.$name                        = "ti_thread_security_thread_security0";

/**
 * Pinmux solution for unlocked pins/peripherals. This ensures that minor changes to the automatic solver in a future
 * version of the tool will not impact the pinmux you originally saw.  These lines can be completely deleted in order to
 * re-solve from scratch.
 */
Display1.uart.uart.txPin.$suggestSolution = "boosterpack.4";
Display1.uart.uart.rxPin.$suggestSolution = "boosterpack.3";
GPIO1.gpioPin.$suggestSolution            = "boosterpack.13";
GPIO2.gpioPin.$suggestSolution            = "boosterpack.12";
GPIO3.gpioPin.$suggestSolution            = "boosterpack.40";
GPIO4.gpioPin.$suggestSolution            = "boosterpack.39";
I2C1.i2c.$suggestSolution                 = "I2C0";
I2C1.i2c.sdaPin.$suggestSolution          = "boosterpack.10";
I2C1.i2c.sclPin.$suggestSolution          = "boosterpack.9";
